## apps/auth/esp32/sdkconfig.defaults
```kconfig
CONFIG_IOTO_DATABASE=n
CONFIG_IOTO_KEYS=n
CONFIG_IOTO_LOGS=n
CONFIG_IOTO_MQTT=n
CONFIG_IOTO_PROVISION=n
CONFIG_IOTO_REGISTER=n
CONFIG_IOTO_SERIALIZE=n
CONFIG_IOTO_SHADOW=n
CONFIG_IOTO_SYNC=n
CONFIG_IOTO_UPDATE=n
CONFIG_IOTO_URL=n
CONFIG_IOTO_WEB=n

CONFIG_FREERTOS_USE_TRACE_FACILITY=y
CONFIG_FREERTOS_USE_STATS_FORMATTING_FUNCTIONS=y
CONFIG_MBEDTLS_EXTERNAL_MEM_ALLOC=y

CONFIG_SPIRAM=y
CONFIG_SPIRAM_MODE_OCT=y
CONFIG_SPIRAM_TYPE_AUTO=y
CONFIG_SPIRAM_USE_MALLOC=y
CONFIG_SPIRAM_ALLOW_STACK_EXTERNAL_MEMORY=y
CONFIG_SPIRAM_MALLOC_ALWAYSINTERNAL=4096

CONFIG_PARTITION_TABLE_CUSTOM=y
CONFIG_PARTITION_TABLE_CUSTOM_FILENAME="partitions.csv"
CONFIG_LITTLEFS_MALLOC_STRATEGY_SPIRAM=y
CONFIG_LITTLEFS_MALLOC_STRATEGY_DISABLE=n
CONFIG_LITTLEFS_MALLOC_STRATEGY_DEFAULT=n

CONFIG_ESPTOOLPY_FLASHSIZE="8MB"
CONFIG_ESPTOOLPY_FLASHSIZE_8MB=y

CONFIG_ESP_DEFAULT_CPU_FREQ_MHZ_240=y
CONFIG_ESP_DEFAULT_CPU_FREQ_MHZ=240

CONFIG_ESP_MAIN_TASK_STACK_SIZE=8192
```

## apps/demo/esp32/Kconfig
```kconfig
#
#   Ioto Services
#

menu "Ioto"

    config IOTO_DATABASE
        bool "Ioto Database support"
        default y
        help
            Enable the in-memory JSON database. Required for most functions.

    config IOTO_KEYS
        bool "Download AWS access keys"
        default n
        help
            Generate and download AWS IAM temporary keys to use with AWS APIs
            Define maximum number of partitions that can be mounted.

    config IOTO_LOGS
        bool "Send device logs to AWS CloudWatch"
        default n
        help
            Send the ESP-32 and Ioto logs to AWS CloudWatch.

    config IOTO_MQTT
        bool "Enable MQTT messaging with the cloud"
        default y
        help
            Enable MQTT messaging. Required for cloud integration.

    config IOTO_PROVISION
        bool "Provision Ioto with an X509 certificate"
        default y
        help
            Generates and provisions the ESP32 with a unique X.509 certificate and key.

    config IOTO_REGISTER
        bool "Register with the EmbedThis Ioto service"
        default y
        help
            Register the device with the Ioto cloud service so it can be claimed / paired for management.

    config IOTO_SERIALIZE
        string "Serialize the device"
        default "auto"
        help
            Generate and save a unique serial number for the device. This number is then used when pairing / claiming the device for management.

    config IOTO_SHADOW
        bool "AWS IoT Core Shadows"
        default n
        help
            Enable to support and integrate with AWS IoT Core Shadows.

    config IOTO_SYNC
        bool "Transparent database synchronization"
        default y
        help
            Enable to transparently synchronize device database data with the cloud.
            This is a bi-directional synchronization that can controlled on a per-table basis via the database schema.

    config IOTO_UPDATE
        bool "Device Updates"
        default "y"
        help
            Enable device OTA updates distributed via the EmbedThis Builder.
    
    config IOTO_URL
        bool "Ioto HTTP Client"
        default "y"
        help
            Enable the Ioto URL API to support simple client-side HTTP requests.
            Required for cloud integration.

    config IOTO_WEB
        bool "Ioto HTTP Server"
        default "y"
        help
            Enable the Ioto high performance embedded web server for local device management.

#    config SPIRAM_MALLOC_ALWAYSINTERNAL
#        int "Allocate internal memory for SPIRAM"
#        default 8192 

endmenu
```

## apps/demo/esp32/sdkconfig.defaults
```kconfig
CONFIG_IOTO_DATABASE=y
CONFIG_IOTO_KEYS=n
CONFIG_IOTO_LOGS=n
CONFIG_IOTO_MQTT=y
CONFIG_IOTO_PROVISION=y
CONFIG_IOTO_REGISTER=y
CONFIG_IOTO_SERIALIZE="auto"
CONFIG_IOTO_SHADOW=n
CONFIG_IOTO_SYNC=y
CONFIG_IOTO_UPDATE=y
CONFIG_IOTO_URL=y
CONFIG_IOTO_WEB=y

CONFIG_FREERTOS_USE_TRACE_FACILITY=y
CONFIG_FREERTOS_USE_STATS_FORMATTING_FUNCTIONS=y
CONFIG_MBEDTLS_EXTERNAL_MEM_ALLOC=y

CONFIG_SPIRAM=y
CONFIG_SPIRAM_MODE_OCT=y
CONFIG_SPIRAM_TYPE_AUTO=y
CONFIG_SPIRAM_USE_MALLOC=y
CONFIG_SPIRAM_ALLOW_STACK_EXTERNAL_MEMORY=y
CONFIG_SPIRAM_MALLOC_ALWAYSINTERNAL=4096

CONFIG_PARTITION_TABLE_CUSTOM=y
CONFIG_PARTITION_TABLE_CUSTOM_FILENAME="partitions.csv"
CONFIG_LITTLEFS_MALLOC_STRATEGY_SPIRAM=y
CONFIG_LITTLEFS_MALLOC_STRATEGY_DISABLE=n
CONFIG_LITTLEFS_MALLOC_STRATEGY_DEFAULT=n

CONFIG_ESPTOOLPY_FLASHSIZE="8MB"
CONFIG_ESPTOOLPY_FLASHSIZE_8MB=y

CONFIG_ESP_DEFAULT_CPU_FREQ_MHZ_240=y
CONFIG_ESP_DEFAULT_CPU_FREQ_MHZ=240

CONFIG_ESP_MAIN_TASK_STACK_SIZE=8192
CONFIG_TASK_WDT_TIMEOUT_S=30
```
